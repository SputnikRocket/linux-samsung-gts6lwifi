## arch/arm64/Kconfig
```kconfig
config XEN
	bool "Xen guest support on ARM64"
	depends on ARM64 && OF
	select SWIOTLB_XEN
	select PARAVIRT
	help
	  Say Y if you want to run Linux in a Virtual Machine on Xen on ARM64.

config OKL4_GUEST
	bool "OKL4 hypervisor guest support"
	default n
	help
	  Say Y if you want to run Linux as a guest of the OKL4 hypervisor

config UH
	bool "Enable micro hypervisor feature of Samsung"
	depends on !SEC_FACTORY
	default n
	help
	  It enables a micro hypervisor.
	  It's samsung's hypervisor and it should be combined with QC hyp.
	  So you must check a hypX(samsung hypervisor image)
	  RKP and etc can be loaded on it.

config UH_RKP
	bool "Enable RKP (Realtime Kernel Protection) UH feature"
	depends on !SEC_FACTORY
	select UH
	default n
	help
	  it protects a kernel text and etc.

config RKP_TEST
	bool "Enables rkp test"
	depends on UH_RKP && !SAMSUNG_PRODUCT_SHIP
	default n
	help
	  it enables rkp test.

config RKP_KDP
	bool "Protection for cred structure"
	depends on !SEC_FACTORY
	depends on !SEC_VTS_TEST
	depends on UH_RKP
	default n
	help
	  Prevents unauthorized cred modification.

config RKP_KDP_TEST
	bool "Enable KDP test"
	depends on RKP_KDP && RKP_NS_PROT && !SAMSUNG_PRODUCT_SHIP
	default n
	help
	  enable KDP test.

config RANDOMIZE_MODULE_REGION_FULL
	bool "Randomize the module region independently from the core kernel"
	depends on RANDOMIZE_BASE
	default y
	help
	  Randomizes the location of the module region without considering the
	  location of the core kernel. This way, it is impossible for modules
	  to leak information about the location of core kernel data structures
	  but it does imply that function calls between modules and the core
	  kernel will need to be resolved via veneers in the module PLT.

	  When this option is not set, the module region will be randomized over
	  a limited range that contains the [_stext, _etext] interval of the
	  core kernel, so branch relocations are always in range.

config EFI
	bool "UEFI runtime support"
	depends on OF && !CPU_BIG_ENDIAN
	select LIBFDT
	select UCS2_STRING
	select EFI_PARAMS_FROM_FDT
	select EFI_RUNTIME_WRAPPERS
	select EFI_STUB
	select EFI_ARMSTUB
	default y
	help
	  This option provides support for runtime services provided
	  by UEFI firmware (such as non-volatile variables, realtime
	  clock, and platform reset). A UEFI stub is also provided to
	  allow the kernel to be booted as an EFI application. This
	  is only useful on systems that have UEFI firmware.

config COMPAT
	bool "Kernel support for 32-bit EL0"
	depends on ARM64_4K_PAGES || EXPERT
	select COMPAT_BINFMT_ELF if BINFMT_ELF
	select HAVE_UID16
	select OLD_SIGSUSPEND3
	select COMPAT_OLD_SIGACTION
	help
	  This option enables support for a 32-bit EL0 running under a 64-bit
	  kernel at EL1. AArch32-specific components such as system calls,
	  the user helper functions, VFP support and the ptrace interface are
	  handled appropriately by the kernel.

	  If you use a page size other than 4KB (i.e, 16KB or 64KB), please be aware
	  that you will only be able to execute AArch32 binaries that were compiled
	  with page size aligned segments.

	  If you want to execute 32-bit userspace applications, say Y.

config SEC_GTS6LWIFI_PROJECT
	default n
	bool "Samsung GTS6LWIFI Project"
	help
	  Support for Samsung GTS6LWIFI Project

config MACH_GTS6LWIFI_EUR_OPEN
        default n
        bool "Samsung GTS6LWIFI EUR OPEN"
        help
          Support for Samsung GTS6LWIFI EUR OPEN device.
```
